## zmk-config/boards/shields/achamian/Kconfig.shield
```kconfig
config SHIELD_ACHAMIAN_LEFT
    def_bool $(shields_list_contains,achamian_left)

config SHIELD_ACHAMIAN_RIGHT
    def_bool $(shields_list_contains,achamian_right)
```
